// generated by mBlock5 for mBot Ranger
// codes make you happy l

#include <Arduino.h>
#include <Wire.h>
#include <SoftwareSerial.h>
#include <MeAuriga.h>

MeLightSensor lightsensor_12(12);
MeUltrasonicSensor ultraschall_vorne(7);
MeUltrasonicSensor ultraschall_rechts(8);
MeEncoderOnBoard Motor_1(SLOT1);
MeEncoderOnBoard Motor_2(SLOT2);

void isr_process_encoder1(void)
{
  if(digitalRead(Motor_1.getPortB()) == 0){
    Motor_1.pulsePosMinus();
  }else{
    Motor_1.pulsePosPlus();
  } 
}
void isr_process_encoder2(void)
{
  if(digitalRead(Motor_2.getPortB()) == 0){
    Motor_2.pulsePosMinus();
  }else{
    Motor_2.pulsePosPlus();
  }
}
//Bis hier nur Konfig
void move(int direction, int speed)
{

  int leftSpeed = 0;
  int rightSpeed = 0;
  if(direction == 1){       //vorwärts
    leftSpeed = -speed;
    rightSpeed = speed;
  }else if(direction == 2){ //rückwärts
    leftSpeed = speed;
    rightSpeed = -speed;
  }else if(direction == 3){ //links
    leftSpeed = -speed;
    rightSpeed = -speed;
  }else if(direction == 4){ //rechts
    leftSpeed = speed;
    rightSpeed = speed;
  }
  Motor_1.setTarPWM(leftSpeed);
  Motor_2.setTarPWM(rightSpeed);
}

void _delay(float seconds) {
  if(seconds < 0.0){
    seconds = 0.0;
  }
  long endTime = millis() + seconds * 1000;
  while(millis() < endTime) _loop();
}

void setup() {
  randomSeed((unsigned long)(lightsensor_12.read() * 123456));
  TCCR1A = _BV(WGM10);
  TCCR1B = _BV(CS11) | _BV(WGM12);
  TCCR2A = _BV(WGM21) | _BV(WGM20);
  TCCR2B = _BV(CS21);
  attachInterrupt(Motor_1.getIntNum(), isr_process_encoder1, RISING);
  attachInterrupt(Motor_2.getIntNum(), isr_process_encoder2, RISING);
  while(1) {
      if(ultraschall_vorne.distanceCm() > 10){

        move(1, 50 / 100.0 * 255);

      }else{

        move(3, 50 / 100.0 * 255);

      }

      _loop();
  }

}



void _loop() {
  Motor_1.loop();
  Motor_2.loop();
}

void loop() {
  _loop();
}
