// generated by mBlock5 for mBot Ranger
// codes make you happy

#include <Arduino.h>
#include <Wire.h>
#include <SoftwareSerial.h>
#include <MeAuriga.h>

MeLightSensor lightsensor_12(12);

MeEncoderNew EmotorV2_7_1(0x11+ 7, 1);
MeEncoderNew EmotorV2_7_2(0x11+ 7, 2);

void _delay(float seconds) {
  if(seconds < 0.0){
    seconds = 0.0;
  }
  long endTime = millis() + seconds * 1000;
  while(millis() < endTime) _loop();
}

void setup() {
  randomSeed((unsigned long)(lightsensor_12.read() * 123456));
  EmotorV2_7_1.begin();
  EmotorV2_7_2.begin();
  while(1) {
      EmotorV2_7_1.setPWM(-15/100.0*255);

      EmotorV2_7_2.setPWM(-10/100.0*255);

      _loop();
  }

}

void _loop() {
}

void loop() {
  _loop();
}
